## board/myir/myd-js8mpq/Kconfig
```kconfig
if TARGET_MYD_JS8MPQ

config SYS_BOARD
	default "myd-js8mpq"

config SYS_VENDOR
	default "myir"

config SYS_CONFIG_NAME
	default "myd-js8mpq"

config IMX_CONFIG
	default "board/myir/myd-js8mpq/imximage-8mp-lpddr4.cfg"

endif
```

## board/myir/myd_jmx95/Kconfig
```kconfig
if TARGET_MYD_JMX95_15X15

config SYS_BOARD
	default "myd_jmx95"

config SYS_VENDOR
	default "myir"

config SYS_CONFIG_NAME
	default "myd_jmx95"

endif
```

## board/myir/myd_lmx93x/Kconfig
```kconfig
if TARGET_MYD_LMX93X_11X11 

config SYS_BOARD
	default "myd_lmx93x"

config SYS_VENDOR
	default "myir"

config SYS_CONFIG_NAME
	default "myd_lmx93x"



choice
	prompt "DDR Size Configuration"
	default MYD_IMX93_LPDDR4X_1G

config MYD_IMX93_LPDDR4X_1G
	bool "LPDDR4 1GB"
	select IMX9_LPDDR4X

config MYD_IMX93_LPDDR4X_2G
	bool "LPDDR4 2GB"
	select IMX9_LPDDR4X

endchoice



endif
```

## board/myir/myd_lmx9x/Kconfig
```kconfig
if TARGET_MYD_LMX9X_11X11 

config SYS_BOARD
	default "myd_lmx9x"

config SYS_VENDOR
	default "myir"

config SYS_CONFIG_NAME
	default "myd_lmx9x"



choice
	prompt "DDR Size Configuration"
	default MYD_LMX9X_LPDDR4X_1G

config MYD_LMX9X_LPDDR4X_1G
	bool "LPDDR4 1GB"
	select IMX9_LPDDR4X

config MYD_LMX9X_LPDDR4X_2G
	bool "LPDDR4 2GB"
	select IMX9_LPDDR4X

endchoice



endif
```

## board/myir/myd_y6ull_14x14/Kconfig
```kconfig
if TARGET_MYD_MX6ULL_14X14

config MYD_DDR_CAPACITY_MB
	int "MYD board physical DDR size (MiB, for reporting and kernel DT fixup)"
	default 256
	range 0 1024
	help
	  imx_ddr_size() reads MMDC geometry and can over-report versus actual
	  populated DRAM. U-Boot clamps gd->ram_size to this value so
	  arch_fixup_fdt() passes the correct /memory reg to Linux.

	  Use 0 to disable clamping (gd->ram_size = imx_ddr_size() only). This
	  can serve a single NAND image on 256 MiB and 512 MiB boards when MMDC
	  reports the true size; if any SKU over-reports, build per-SKU defconfig
	  with 256 / 512 instead.

	  Typical values: 256 (DDR256 NAND / default), 512 (DDR512 NAND or eMMC).

config SYS_BOARD
	default "myd_y6ull_14x14"

config SYS_VENDOR
	default "myir"

config SYS_CONFIG_NAME
	default "myd_y6ull_14x14"
	
config IMX_CONFIG
	default "board/myir/myd_y6ull_14x14/imximage.cfg"
	
config TEXT_BASE
	default 0x87800000
endif
```

## board/myir/mys_imx91/Kconfig
```kconfig
if TARGET_MYS_IMX91_11X11

config SYS_BOARD
	default "mys_imx91"

config SYS_VENDOR
	default "myir"

config SYS_CONFIG_NAME
	default "mys_imx91"

config IMX91_EVK_LPDDR4
	bool "Using LPDDR4 Timing and PMIC voltage"
	default y
	select IMX9_LPDDR4X
	help
	  Select the LPDDR4 timing and 1.1V VDDQ

endif
```

## configs/myd_imx6ull_nand_ddr256_defconfig
```kconfig
CONFIG_ARM=y
CONFIG_ARCH_MX6=y
CONFIG_SYS_MALLOC_LEN=0x1000000
CONFIG_NR_DRAM_BANKS=1
CONFIG_SYS_MEMTEST_START=0x80000000
CONFIG_SYS_MEMTEST_END=0x90000000
CONFIG_MYD_DDR_CAPACITY_MB=256
CONFIG_IMX_CONFIG="board/myir/myd_y6ull_14x14/imximage.cfg"
CONFIG_ENV_SIZE=0x20000
# Env at base of gpmi env partition (layout in myd_y6ull_14x14.h)
CONFIG_ENV_OFFSET=0x500000
CONFIG_SYS_REDUNDAND_ENVIRONMENT=y
CONFIG_ENV_OFFSET_REDUND=0x520000
CONFIG_MX6ULL=y
CONFIG_TARGET_MYD_MX6ULL_14X14=y
# CONFIG_LDO_BYPASS_CHECK is not set
CONFIG_SYS_I2C_MXC_I2C1=y
CONFIG_SYS_I2C_MXC_I2C2=y
CONFIG_DM_GPIO=y
CONFIG_DEFAULT_DEVICE_TREE="myd-y6ull-14x14-nand-ddr256"
CONFIG_WATCHDOG_TIMEOUT_MSECS=60000
CONFIG_SUPPORT_RAW_INITRD=y
CONFIG_USE_BOOTCOMMAND=y
CONFIG_BOOTCOMMAND="run findfdt;mmc dev ${mmcdev};mmc dev ${mmcdev}; if mmc rescan; then if run loadbootscript; then run bootscript; else if run loadimage; then run mmcboot; else run nandboot; fi; fi; else run nandboot; fi"
CONFIG_NAND_BOOT=y
CONFIG_CMD_NAND=y
CONFIG_CMD_NAND_TRIMFFS=y
CONFIG_CMD_UBI=y
CONFIG_MTD=y
CONFIG_DM_MTD=y
CONFIG_MTD_RAW_NAND=y
CONFIG_CMD_MTD=y
CONFIG_CMD_MTDPARTS=y
CONFIG_MTDIDS_DEFAULT="nand0=gpmi-nand"
CONFIG_MTDPARTS_SKIP_INVALID=y
CONFIG_MTDPARTS_DEFAULT="gpmi-nand:5m(boot),1m(env),10m(kernel),1m(dtb),-(rootfs)"
CONFIG_NAND=y
CONFIG_NAND_MXS=y
CONFIG_NAND_MXS_DT=y
CONFIG_NAND_MXS_USE_MINIMUM_ECC=y
CONFIG_SYS_NAND_USE_FLASH_BBT=y
CONFIG_SYS_NAND_ONFI_DETECTION=y
CONFIG_ENV_IS_IN_NAND=y
CONFIG_BOOTDELAY=3
# CONFIG_CONSOLE_MUX is not set
CONFIG_SYS_CONSOLE_IS_IN_ENV=y
CONFIG_BOARD_EARLY_INIT_F=y
CONFIG_BOARD_EARLY_INIT_R=y
CONFIG_BOARD_LATE_INIT=y
CONFIG_HUSH_PARSER=y
CONFIG_SYS_MAXARGS=32
CONFIG_SYS_PBSIZE=532
CONFIG_CMD_BOOTZ=y
# CONFIG_CMD_IMLS is not set
CONFIG_CMD_MEMTEST=y
CONFIG_CMD_GPIO=y
CONFIG_CMD_I2C=y
CONFIG_CMD_MMC=y
CONFIG_CMD_USB=y
CONFIG_CMD_DHCP=y
CONFIG_CMD_PING=y
CONFIG_CMD_BMP=y
CONFIG_CMD_CACHE=y
CONFIG_CMD_NET=y
CONFIG_CMD_EXT2=y
CONFIG_CMD_EXT4=y
CONFIG_CMD_EXT4_WRITE=y
CONFIG_CMD_FAT=y
CONFIG_CMD_FS_GENERIC=y
CONFIG_OF_CONTROL=y
CONFIG_ENV_OVERWRITE=y
CONFIG_SYS_RELOC_GD_ENV_ADDR=y
CONFIG_SYS_MMC_ENV_DEV=0
CONFIG_ENV_VARS_UBOOT_RUNTIME_CONFIG=y
CONFIG_USE_ETHPRIME=y
CONFIG_ETHPRIME="eth1"
CONFIG_BOUNCE_BUFFER=y
CONFIG_DM_74X164=y
CONFIG_DM_I2C=y
CONFIG_SYS_I2C_MXC=y
CONFIG_FSL_USDHC=y
CONFIG_PHYLIB=y
CONFIG_PHY_MICREL=y
CONFIG_PHY_MICREL_KSZ8XXX=y
CONFIG_DM_ETH_PHY=y
CONFIG_FEC_MXC=y
CONFIG_MII=y
CONFIG_PINCTRL=y
CONFIG_PINCTRL_IMX6=y
CONFIG_DM_REGULATOR=y
CONFIG_DM_REGULATOR_FIXED=y
CONFIG_DM_REGULATOR_GPIO=y
CONFIG_DM_SERIAL=y
CONFIG_MXC_UART=y
CONFIG_SPI=y
CONFIG_DM_SPI=y
CONFIG_SOFT_SPI=y
CONFIG_IMX_THERMAL=y
CONFIG_ARCH_MISC_INIT=y
CONFIG_SYSRESET=y
CONFIG_SYSRESET_WATCHDOG=y
CONFIG_SYSRESET_WATCHDOG_AUTO=y
CONFIG_IMX_WATCHDOG=y
CONFIG_DM_RNG=y
CONFIG_CMD_RNG=y
CONFIG_FSL_DCP_RNG=y
CONFIG_USB=y
CONFIG_USB_MAX_CONTROLLER_COUNT=2
CONFIG_USB_STORAGE=y
CONFIG_CMD_USB_MASS_STORAGE=y
CONFIG_USB_HOST_ETHER=y
CONFIG_USB_ETHER_ASIX=y
CONFIG_VIDEO=y
CONFIG_VIDEO_LINK=y
CONFIG_VIDEO_LOGO=y
CONFIG_VIDEO_MXS=y
CONFIG_SPLASH_SCREEN=y
CONFIG_SPLASH_SCREEN_ALIGN=y
CONFIG_SPLASH_DEFAULT_CENTER=y
CONFIG_SYS_WHITE_ON_BLACK=y
CONFIG_HIDE_LOGO_VERSION=y
CONFIG_BMP_16BPP=y

CONFIG_USB_GADGET=y
CONFIG_USB_GADGET_DOWNLOAD=y
CONFIG_USB_GADGET_MANUFACTURER="FSL"
CONFIG_USB_GADGET_VENDOR_NUM=0x1fc9
CONFIG_USB_GADGET_PRODUCT_NUM=0x0152
CONFIG_CI_UDC=y

CONFIG_CMD_FASTBOOT=y
CONFIG_USB_FUNCTION_FASTBOOT=y
CONFIG_FASTBOOT_UUU_SUPPORT=y
CONFIG_FASTBOOT=y
CONFIG_FASTBOOT_BUF_ADDR=0x83800000
CONFIG_FASTBOOT_BUF_SIZE=0x40000000
CONFIG_FASTBOOT_FLASH=y
CONFIG_EFI_PARTITION=y
CONFIG_CMD_CRC32=y
CONFIG_CRC32_VERIFY=y
```
