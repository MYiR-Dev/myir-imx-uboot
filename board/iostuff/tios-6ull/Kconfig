## board/iostuff/tios-6ull/Kconfig
```kconfig
if TARGET_TIOS_6ULL

config SYS_BOARD
	default "tios-6ull"

config SYS_VENDOR
	default "iostuff"

config SYS_CONFIG_NAME
	default "tios-6ull"

config SYS_TEXT_BASE
	default 0x87800000
endif
```

## board/myir/myd_imx6ul_14x14/Kconfig
```kconfig
if TARGET_MYD_MX6UL_14X14 || TARGET_MX6UL_9X9_EVK

config SYS_BOARD
	default "myd_imx6ul_14x14"

config SYS_VENDOR
	default "myir"

config SYS_CONFIG_NAME
	default "myd_imx6ul_14x14"

config MX6UL_14X14_EVK_EMMC_REWORK
	bool "Select this for the board with eMMC rework"

config SYS_TEXT_BASE
	default 0x87800000
endif
```

## board/myir/myd_imx6ull_14x14/Kconfig
```kconfig
if TARGET_MYD_MX6ULL_14X14 || TARGET_MX6ULL_14X14_EVK || TARGET_MX6ULL_9X9_EVK

config SYS_BOARD
	default "myd_imx6ull_14x14"

config SYS_VENDOR
	default "myir"

config SYS_CONFIG_NAME
	default "myd_imx6ull_14x14"

config SYS_TEXT_BASE
	default 0x87800000
endif
```

## board/myir/myd_imx8mm/Kconfig
```kconfig
if  TARGET_MYD_IMX8MM_DDR4

config SYS_BOARD
	default "myd_imx8mm"

config SYS_VENDOR
	default "myir"

config SYS_CONFIG_NAME
	default "myd_imx8mm"

source "board/myir/common/Kconfig"

endif
```

## board/myir/myd_jx8mm/Kconfig
```kconfig
if  TARGET_MYD_JX8MM_LPDDR4

config SYS_BOARD
	default "myd_jx8mm"

config SYS_VENDOR
	default "myir"

config SYS_CONFIG_NAME
	default "myd_jx8mm"

source "board/myir/common/Kconfig"

endif
```

## board/myir/myd_jx8mp/Kconfig
```kconfig
if TARGET_MYD_JX8MP_LPDDR4_EVK

config SYS_BOARD
	default "myd_jx8mp"

config SYS_VENDOR
	default "myir"

config SYS_CONFIG_NAME
	default "myd_jx8mp"

source "board/myir/common/Kconfig"

endif
```

## board/myir/myd_jx8mx/Kconfig
```kconfig
if TARGET_MYD_JX8MX_LPDDR4_EVK

config SYS_BOARD
	default "myd_jx8mx"

config SYS_VENDOR
	default "myir"

config SYS_CONFIG_NAME
	default "myd_jx8mx"

source "board/myir/common/Kconfig"

endif
```

## board/myir/myd_y6ul_14x14/Kconfig
```kconfig
if TARGET_MYD_Y6UL_14X14 || TARGET_MYD_Y6UL_9X9

config SYS_BOARD
	default "myd_y6ul_14x14"

config SYS_VENDOR
	default "myir"

config SYS_CONFIG_NAME
	default "myd_y6ul_14x14"

endif
```

## board/myir/myd_y6ull/Kconfig
```kconfig
if TARGET_MYD_Y6ULL_14X14 || TARGET_MX6ULL_9X9_EVK

config SYS_BOARD
	default "myd_y6ull"

config SYS_VENDOR
	default "myir"

config SYS_CONFIG_NAME
	default "myd_y6ull"

endif
```

## board/myir/mys-6ull-14x14/Kconfig
```kconfig
if TARGET_MYS_6ULL_14X14

config SYS_BOARD
	default "mys-6ull-14x14"

config SYS_VENDOR
	default "myir"

config SYS_CONFIG_NAME
	default "mys-6ull-14x14"

config SYS_TEXT_BASE
	default 0x87800000
endif
```

## board/myir/mys_imx6ul_14x14/Kconfig
```kconfig
if TARGET_MYS_IMX6UL_14X14 || TARGET_MYS_IMX6UL_9X9

config SYS_BOARD
	default "mys_imx6ul_14x14"

config SYS_VENDOR
	default "myir"

config SYS_CONFIG_NAME
	default "mys_imx6ul_14x14"

endif
```

## board/myir/mys_imx6ull/Kconfig
```kconfig
if TARGET_MYS_IMX6ULL_14X14 || TARGET_MX6ULL_9X9_EVK

config SYS_BOARD
	default "mys_imx6ull"

config SYS_VENDOR
	default "myir"

config SYS_CONFIG_NAME
	default "mys_imx6ull"

endif
```

## board/myir/mys_iot_imx8mm/Kconfig
```kconfig
if  TARGET_MYS_IOT_IMX8MM_DDR4_EVK

config SYS_BOARD
	default "mys_iot_imx8mm"

config SYS_VENDOR
	default "myir"

config SYS_CONFIG_NAME
	default "mys_iot_imx8mm"

source "board/myir/common/Kconfig"

endif
```

## configs/myd_y6ul_14x14_emmc_defconfig
```kconfig
CONFIG_ARM=y
CONFIG_ARCH_MX6=y
CONFIG_TARGET_MYD_Y6UL_14X14=y
CONFIG_SYS_EXTRA_OPTIONS="IMX_CONFIG=board/myir/myd_y6ul_14x14/imximage.cfg,SYS_BOOT_EMMC,DDR_SIZE=512"
CONFIG_CMD_GPIO=y
CONFIG_CMD_DHCP=y
CONFIG_CMD_PING=y
```

## configs/myd_y6ul_14x14_nand_defconfig
```kconfig
CONFIG_ARM=y
CONFIG_ARCH_MX6=y
CONFIG_TARGET_MYD_Y6UL_14X14=y
CONFIG_SYS_EXTRA_OPTIONS="IMX_CONFIG=board/myir/myd_y6ul_14x14/imximage.cfg,SYS_BOOT_NAND"
CONFIG_CMD_GPIO=y
CONFIG_CMD_DHCP=y
CONFIG_CMD_PING=y
```

## configs/myd_y6ull_14x14_emmc_defconfig
```kconfig
CONFIG_SYS_EXTRA_OPTIONS="IMX_CONFIG=board/myir/myd_y6ull/imximage.cfg,SYS_BOOT_EMMC,DDR_SIZE=512"
CONFIG_ARM=y
CONFIG_ARCH_MX6=y
CONFIG_TARGET_MYD_Y6ULL_14X14=y
CONFIG_CMD_GPIO=y
```

## configs/mys_imx6ul_14x14_nand_defconfig
```kconfig
CONFIG_ARM=y
CONFIG_ARCH_MX6=y
CONFIG_TARGET_MYS_IMX6UL_14X14=y
CONFIG_SYS_EXTRA_OPTIONS="IMX_CONFIG=board/myir/mys_imx6ul_14x14/imximage.cfg,SYS_BOOT_NAND"
CONFIG_CMD_GPIO=y
CONFIG_CMD_DHCP=y
CONFIG_CMD_PING=y
```

## configs/mys_imx6ull_14x14_emmc_defconfig
```kconfig
CONFIG_SYS_EXTRA_OPTIONS="IMX_CONFIG=board/myir/mys_imx6ull/imximage.cfg,SYS_BOOT_EMMC,DDR_SIZE=512"
CONFIG_ARM=y
CONFIG_ARCH_MX6=y
CONFIG_TARGET_MYS_IMX6ULL_14X14=y
CONFIG_CMD_GPIO=y
```

## configs/mys_imx6ull_14x14_nand_defconfig
```kconfig
CONFIG_SYS_EXTRA_OPTIONS="IMX_CONFIG=board/myir/mys_imx6ull/imximage.cfg,SYS_BOOT_NAND,DDR_SIZE=256"
CONFIG_ARM=y
CONFIG_ARCH_MX6=y
CONFIG_TARGET_MYS_IMX6ULL_14X14=y
CONFIG_CMD_GPIO=y
```
